## drivers/net/wireless/unisoc/Kconfig
```kconfig
# SPDX-License-Identifier: GPL-2.0
# Unisoc UWE5621DS WIFI/BT drivers

config SPARD_WLAN_SUPPORT
	bool "Unisoc UWE5621DS WIFI/BT Support"
	select RK_WIFI_DEVICE_UWE5621
	default n
	help
	  This enables support for Unisoc UWE5621DS combo chip
	  (WiFi SDIO + Bluetooth UART) on Rockchip platforms.

if SPARD_WLAN_SUPPORT
source "drivers/net/wireless/unisoc/unisocwcn/Kconfig"
source "drivers/net/wireless/unisoc/unisocwifi/Kconfig"
source "drivers/net/wireless/unisoc/tty-sdio/Kconfig"
endif
```

## drivers/net/wireless/unisoc/tty-sdio/Kconfig
```kconfig
# SPDX-License-Identifier: GPL-2.0
config TTY_OVERY_SDIO
	tristate "UWE5621 Bluetooth TTY over SDIO"
	depends on RK_WIFI_DEVICE_UWE5621
	help
	  This provides the Bluetooth HCI TTY interface for UWE5621 chip.
	  When compiled as a module, it will be called sprdbt_tty.ko.
```

## drivers/net/wireless/unisoc/unisocwcn/Kconfig
```kconfig
# SPDX-License-Identifier: GPL-2.0
config RK_WIFI_DEVICE_UWE5621
	bool "Rockchip UWE5621 BSP Support"
	default n
	help
	  Build the UWE5621 BSP (firmware download, power management)
	  driver for Rockchip platforms.

config WCN_BSP_DRIVER_BUILDIN
	bool "Build BSP driver into kernel"
	depends on RK_WIFI_DEVICE_UWE5621
	default n
	help
	  Build the UWE5621 BSP driver statically into the kernel.
```

## drivers/net/wireless/unisoc/unisocwifi/Kconfig
```kconfig
# SPDX-License-Identifier: GPL-2.0
config SPRDWL_NG
	tristate "UWE5621 WiFi Driver (sprdwl_ng)"
	depends on CFG80211
	help
	  This is the WiFi driver for Unisoc UWE5621 SDIO chip.
	  When compiled as a module, it will be called sprdwl_ng.ko.
```

## net/802/Kconfig
```kconfig
# SPDX-License-Identifier: GPL-2.0-only
config STP
	bool
	select LLC

config GARP
	tristate
	select STP

config MRP
	tristate
```
